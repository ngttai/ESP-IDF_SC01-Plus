## main/Kconfig.projbuild
```kconfig
menu "SC01 Plus Configuration"

    config SC01_PLUS_LCD_I80_COLOR_IN_PSRAM
        bool "Allocate color data from PSRAM"
        depends on IDF_TARGET_ESP32S3
        default n
        help
            Enable this option if you wish to allocate the color buffer used by LVGL from PSRAM.
            Unmatched PSRAM band width with LCD requirement can lead to blurred image display.

endmenu
```
